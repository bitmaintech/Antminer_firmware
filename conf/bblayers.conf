## conf/bblayers.conf
```bitbake
# LAYER_CONF_VERSION is increased each time build/conf/bblayers.conf
# changes incompatibly
LCONF_VERSION = "5"
TOPDIR := "${@os.path.dirname(os.path.dirname(d.getVar('FILE', True)))}"

BBPATH = "${TOPDIR}"

BBFILES = ""

# These layers hold recipe metadata not found in OE-core, but lack any machine or distro content
BASELAYERS ?= " \
  ${TOPDIR}/sources/meta-openembedded/meta-oe \
  ${TOPDIR}/sources/meta-openembedded/meta-efl \
  ${TOPDIR}/sources/meta-openembedded/meta-gpe \
  ${TOPDIR}/sources/meta-openembedded/meta-gnome \
  ${TOPDIR}/sources/meta-openembedded/meta-xfce \
  ${TOPDIR}/sources/meta-openembedded/meta-initramfs \
  ${TOPDIR}/sources/meta-openembedded/toolchain-layer \
  ${TOPDIR}/sources/meta-openembedded/meta-multimedia \
  ${TOPDIR}/sources/meta-openembedded/meta-networking \
  ${TOPDIR}/sources/meta-openembedded/meta-webserver \
  ${TOPDIR}/sources/meta-openembedded/meta-ruby \
"

# These layers hold machine specific content, aka Board Support Packages
BSPLAYERS ?= " \
  ${TOPDIR}/sources/meta-beagleboard/common-bsp \
  ${TOPDIR}/sources/meta-ti \
"

# Add your overlay location to EXTRALAYERS
# Make sure to have a conf/layers.conf in there
EXTRALAYERS ?= " \
  ${TOPDIR}/sources/meta-linaro/meta-linaro \
  ${TOPDIR}/sources/meta-linaro/meta-linaro-toolchain \
  ${TOPDIR}/sources/meta-antminer \
"

BBLAYERS = " \
  ${TOPDIR}/sources/meta-angstrom \
  ${BASELAYERS} \
  ${BSPLAYERS} \
  ${EXTRALAYERS} \
  ${TOPDIR}/sources/openembedded-core/meta \
  "
```

## conf/local.conf
```bitbake
#Miner_TYPE = "S2"
#Miner_TYPE = "S4"
#Miner_TYPE = "C1"
#Miner_TYPE = "C2"
Miner_TYPE = "S5"
#Miner_TYPE = "S4+"

Miner_Monitor = "YES"

# CONF_VERSION is increased each time build/conf/ changes incompatibly
CONF_VERSION = "1"

#INHERIT += "rm_work"

# Which files do we want to parse:
BBMASK = ""

# What kind of images do we want?
# Build initramfs images
IMAGE_CLASSES += " image_types_uboot"
IMAGE_TYPES += " cpio.gz.u-boot"
IMAGE_FSTYPES += " cpio.gz.u-boot"

# Make use of SMP:
#   PARALLEL_MAKE specifies how many concurrent compiler threads are spawned per bitbake process
#   BB_NUMBER_THREADS specifies how many concurrent bitbake tasks will be run
#PARALLEL_MAKE     = "-j4"
#BB_NUMBER_THREADS = "4"
BB_NUMBER_THREADS = "1"

DISTRO = "angstrom-v2013.06"
# Set DEPLOY_DIR outside of TMPDIR

#DEPLOY_DIR = "${TMPDIR}/../../deploy/${TCLIBC}"
DEPLOY_DIR = "${TMPDIR}/../../../setup-s3/deploy/${TCLIBC}"
# Don't generate the mirror tarball for SCM repos, the snapshot is enough
BB_GENERATE_MIRROR_TARBALLS = "0"

# Disable build time patch resolution. This would lauch a devshell
# and wait for manual intervention. We disable it.
PATCHRESOLVE = "noop"

#
# Shared-state files from other locations
#
# Shared state files are prebuilt cache data objects which can 
# used to accelerate build time. This variable can be used to configure the system
# to search other mirror locations for these objects before it builds the data itself.
#
# This can be a filesystem directory, or a remote url such as http or ftp. These
# would contain the sstate-cache results from previous builds (possibly from other 
# machines). This variable works like fetcher MIRRORS/PREMIRRORS and points to the 
# cache locations to check for the shared objects.
#SSTATE_MIRRORS ?= "\
#file://.* http://someserver.tld/share/sstate/ \n \
#file://.* file:///some/local/dir/sstate/"

#SSTATE_MIRRORS ?= "\
#file://.* http://dominion.thruhere.net/angstrom/sstate-mirror/ \n "

# enable PR service on build machine itself
# its good for a case when this is the only builder
# generating the feeds
#
PRSERV_HOST = "localhost:0"
```

## sources/meta-antminer/conf/layer.conf
```bitbake
# We have a conf and classes directory, append to BBPATH
BBPATH .= ":${LAYERDIR}"

# We have a recipes directory, add to BBFILES
BBFILES += "${LAYERDIR}/recipes*/*/*.bb ${LAYERDIR}/recipes*/*/*.bbappend"

BBFILE_COLLECTIONS += "S3-layer"
BBFILE_PATTERN_S3-layer := "^${LAYERDIR}/"
BBFILE_PRIORITY_S3-layer = "7"
```
